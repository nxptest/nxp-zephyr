## CMakeLists.txt
```
# SPDX-License-Identifier: Apache-2.0

cmake_minimum_required(VERSION 3.20.0)

option(BUILD_IN_DWA "Enable DWA build variant" OFF)

if(USE_DUMMY_CREDS)
  set(creds "src/creds/dummy.c")
else()
  if(NOT EXISTS ${CMAKE_CURRENT_SOURCE_DIR}/src/creds/key.c OR
     NOT EXISTS ${CMAKE_CURRENT_SOURCE_DIR}/src/creds/cert.c OR
     NOT EXISTS ${CMAKE_CURRENT_SOURCE_DIR}/src/creds/ca.c)
    message(FATAL_ERROR
        "Credentials not found. Please run "
        "'python3 src/creds/convert_keys.py' before building"
    )
  endif()

  set(creds "src/creds/ca.c" "src/creds/key.c" "src/creds/cert.c")
endif()

if (BUILD_IN_DWA)
    # Provide path to the root of Matter repository
    if(DEFINED ENV{CHIP_ROOT})
        set(CHIP_ROOT $ENV{CHIP_ROOT})
    else()
        get_filename_component(CHIP_ROOT $ENV{HOME}/matter REALPATH)
    endif()

    get_filename_component(NXP_MATTER_SUPPORT_DIR ${CHIP_ROOT}/third_party/nxp/nxp_matter_support REALPATH)
    get_filename_component(GEN_DIR ${CHIP_ROOT}/zzz_generated/ REALPATH)
    get_filename_component(ALL_CLUSTERS_COMMON_DIR ${CHIP_ROOT}/examples/all-clusters-app/all-clusters-common REALPATH)
    get_filename_component(THERMOSTAT_NXP_ROOT ${CHIP_ROOT}/examples/thermostat/nxp/zephyr REALPATH)
    get_filename_component(THERMOSTAT_NXP_COMMON_DIR ${CHIP_ROOT}/examples/thermostat/nxp/common REALPATH)
    get_filename_component(THERMOSTAT_NXP_ZAP_DIR ${CHIP_ROOT}/examples/thermostat/nxp/zap REALPATH)
    get_filename_component(EXAMPLE_PLATFORM_NXP_COMMON_DIR ${CHIP_ROOT}/examples/platform/nxp/common REALPATH)

    # Add the CHIP stack & NXP port libs as an external module
    list(APPEND ZEPHYR_EXTRA_MODULES ${CHIP_ROOT}/config/nxp/chip-module)

    # Add application prj.conf & Kconfig
    #set(CONF_FILE ${CONF_FILE} ${CMAKE_CURRENT_SOURCE_DIR}/prj.conf)
    set(KCONFIG_ROOT ${CMAKE_CURRENT_SOURCE_DIR}/Kconfig.dwa)

    find_package(Zephyr REQUIRED HINTS $ENV{ZEPHYR_BASE})
    project(wifi)
    enable_language(CXX)

    include(${CHIP_ROOT}/config/nxp/app/enable-gnu-std.cmake)
    include(${CHIP_ROOT}/src/app/chip_data_model.cmake)


    # Add additional configuration
    target_compile_definitions(app
        PRIVATE
        DISABLE_LOGGING
    )

    target_include_directories(app
        PRIVATE
        ${ALL_CLUSTERS_COMMON_DIR}/include
        ${THERMOSTAT_NXP_COMMON_DIR}/main/include
        ${GEN_DIR}/app-common
        ${EXAMPLE_PLATFORM_NXP_COMMON_DIR}/device_manager/include
        ${EXAMPLE_PLATFORM_NXP_COMMON_DIR}/icd/include
        ${EXAMPLE_PLATFORM_NXP_COMMON_DIR}/device_callbacks/include
        ${EXAMPLE_PLATFORM_NXP_COMMON_DIR}/factory_data/include
        ${EXAMPLE_PLATFORM_NXP_COMMON_DIR}/app_task/include
        ${EXAMPLE_PLATFORM_NXP_COMMON_DIR}/matter_button/include
        ${EXAMPLE_PLATFORM_NXP_COMMON_DIR}/app_ble/include
    )

    # Use "main.cpp" of Matter source
    #FILE(GLOB app_sources src/*.c)
    target_sources(app
        PRIVATE
        ${app_sources}
        ${THERMOSTAT_NXP_ROOT}/main/main.cpp
        ${THERMOSTAT_NXP_COMMON_DIR}/main/AppTask.cpp
        ${THERMOSTAT_NXP_COMMON_DIR}/main/DeviceCallbacks.cpp
        ${THERMOSTAT_NXP_COMMON_DIR}/main/ZclCallbacks.cpp
        ${EXAMPLE_PLATFORM_NXP_COMMON_DIR}/device_callbacks/source/CommonDeviceCallbacks.cpp
        ${EXAMPLE_PLATFORM_NXP_COMMON_DIR}/device_manager/source/CHIPDeviceManager.cpp
        ${EXAMPLE_PLATFORM_NXP_COMMON_DIR}/app_task/source/AppTaskBase.cpp
        ${EXAMPLE_PLATFORM_NXP_COMMON_DIR}/app_task/source/AppTaskZephyr.cpp
        ${EXAMPLE_PLATFORM_NXP_COMMON_DIR}/matter_button/source/ButtonRegistrationEmpty.cpp
        ${EXAMPLE_PLATFORM_NXP_COMMON_DIR}/icd/source/ICDUtil.cpp
        ${ALL_CLUSTERS_COMMON_DIR}/src/binding-handler.cpp
        ${EXAMPLE_PLATFORM_NXP_COMMON_DIR}/app_ble/source/BLEApplicationManagerEmpty.cpp
    )

    if(CONFIG_CHIP_WIFI)
        chip_configure_data_model(app
            INCLUDE_SERVER
            ZAP_FILE ${THERMOSTAT_NXP_ZAP_DIR}/thermostat_matter_wifi.zap
        )
    endif()

    if (CONFIG_CHIP_LIB_SHELL)
        target_compile_definitions(app PRIVATE
            ENABLE_CHIP_SHELL
        )

        target_sources(app PRIVATE
            ${EXAMPLE_PLATFORM_NXP_COMMON_DIR}/matter_cli/source/AppCLIBase.cpp
            ${EXAMPLE_PLATFORM_NXP_COMMON_DIR}/matter_cli/source/AppCLIZephyr.cpp
            ${CHIP_ROOT}/examples/shell/shell_common/cmd_misc.cpp
            ${CHIP_ROOT}/examples/shell/shell_common/cmd_otcli.cpp
            ${CHIP_ROOT}/examples/shell/shell_common/cmd_server.cpp
        )

        target_include_directories(app PRIVATE
            ${EXAMPLE_PLATFORM_NXP_COMMON_DIR}/matter_cli/include
            ${CHIP_ROOT}/examples/shell/shell_common/include
        )
    endif()

    if (CONFIG_CHIP_SECURE_DAC_PRIVATE_KEY_STORAGE OR CONFIG_CHIP_ENABLE_SECURE_WHOLE_FACTORY_DATA)
        target_compile_definitions(app PUBLIC
            EXTERNAL_FACTORY_DATA_PROVIDER_IMPL_HEADER=\"platform/nxp/${CONFIG_CHIP_NXP_PLATFORM_FOLDER_NAME}/FactoryDataProviderImpl.h\"
        )
        target_sources(app PRIVATE
            ${EXAMPLE_PLATFORM_NXP_COMMON_DIR}/factory_data/source/AppFactoryDataExample.cpp
        )
    else()
        target_compile_definitions(app PUBLIC
            EXTERNAL_FACTORY_DATA_PROVIDER_IMPL_HEADER=\"platform/nxp/common/factory_data/FactoryDataProviderFwkImpl.h\"
        )
        target_sources(app PRIVATE
            ${EXAMPLE_PLATFORM_NXP_COMMON_DIR}/factory_data/source/AppFactoryDataDefaultImpl.cpp
        )
    endif()

    if (CONFIG_CHIP_OTA_REQUESTOR)
        target_include_directories(app PRIVATE
            ${EXAMPLE_PLATFORM_NXP_COMMON_DIR}/ota_requestor/include
        )
	target_sources(app PRIVATE
            ${EXAMPLE_PLATFORM_NXP_COMMON_DIR}/ota_requestor/source/OTARequestorInitiator.cpp
            ${EXAMPLE_PLATFORM_NXP_COMMON_DIR}/ota_requestor/source/OTARequestorInitiatorCommon.cpp
        )
    endif()
    #message(STATUS "ZEPHYR_EXTRA_MODULES = ${ZEPHYR_EXTRA_MODULES}")

else()
    find_package(Zephyr REQUIRED HINTS $ENV{ZEPHYR_BASE})
    project(wifi)

    FILE(GLOB app_sources src/*.c)
    target_sources(app PRIVATE ${app_sources}  ${creds})
	
	target_include_directories(app PRIVATE ${ZEPHYR_BASE}/samples/net/common)
endif()
```

## Kconfig
```
mainmenu "NXP Matter AWS Wi-Fi Example Applicaion"

rsource "../../../../../../../matter/config/nxp/chip-module/Kconfig.defaults"
rsource "../../../../../../../matter/config/nxp/chip-module/Kconfig.features"
source "Kconfig.zephyr"

config BUILD_IN_DWA
    bool "Enable DWA feature"
    default n
    help
        Enable support for the DWA feature in this build
```

## Kconfig.dwa
```
mainmenu "NXP Matter AWS Wi-Fi Example Applicaion"

source "../../../../../matter/config/nxp/chip-module/Kconfig.defaults"
source "../../../../../matter/config/nxp/chip-module/Kconfig.features"
source "Kconfig.zephyr"

config BUILD_IN_DWA
    bool "Enable DWA feature"
    default n
    help
        Enable support for the DWA feature in this build
```

## prj.conf
```kconfig
CONFIG_EARLY_CONSOLE=y

CONFIG_NETWORKING=y
CONFIG_TEST_RANDOM_GENERATOR=y

CONFIG_MAIN_STACK_SIZE=5200
CONFIG_INIT_STACKS=y
CONFIG_SHELL_STACK_SIZE=5200
CONFIG_NET_TX_STACK_SIZE=2048
CONFIG_NET_RX_STACK_SIZE=2048

CONFIG_NET_PKT_RX_COUNT=32
CONFIG_NET_PKT_TX_COUNT=16
CONFIG_NET_BUF_RX_COUNT=64
CONFIG_NET_BUF_TX_COUNT=32
CONFIG_NET_MAX_CONTEXTS=10
CONFIG_NET_DHCPV4=y

CONFIG_NET_IPV4=y
CONFIG_NET_IPV6=n

CONFIG_NET_TCP=y

CONFIG_NET_LOG=y
CONFIG_INIT_STACKS=y

CONFIG_NET_SHELL=y

CONFIG_NET_STATISTICS=y
CONFIG_NET_STATISTICS_PERIODIC_OUTPUT=n

CONFIG_WIFI=y
CONFIG_WIFI_LOG_LEVEL_ERR=y
CONFIG_NET_L2_WIFI_SHELL=y
# printing of scan results puts pressure on queues in new locking
# design in net_mgmt. So, use a higher timeout for a crowded
# environment.
CONFIG_NET_MGMT_EVENT_QUEUE_TIMEOUT=5000
CONFIG_NET_MGMT_EVENT_QUEUE_SIZE=16

# Setting to save in the flash
CONFIG_NVS=y
CONFIG_SETTINGS=y
CONFIG_SETTINGS_NVS=y
CONFIG_FLASH=y
CONFIG_FLASH_MAP=y

CONFIG_AWS_ENDPOINT="a2a3a07cs36p7a-ats.iot.us-east-1.amazonaws.com"
CONFIG_AWS_MQTT_PORT=8883
CONFIG_AWS_THING_NAME="FRDMRW612_Device"
CONFIG_AWS_PUBLISH_TOPIC="zephyr_sample/data"
CONFIG_AWS_SUBSCRIBE_TOPIC="zephyr_sample/downlink"
CONFIG_AWS_TEST_SUITE_DQP=n

# DNS
CONFIG_DNS_RESOLVER=y
CONFIG_DNS_RESOLVER_ADDITIONAL_BUF_CTR=2
CONFIG_DNS_RESOLVER_MAX_SERVERS=1
CONFIG_DNS_SERVER_IP_ADDRESSES=y
CONFIG_DNS_SERVER1="8.8.8.8"
CONFIG_NET_SOCKETS_DNS_TIMEOUT=5000
CONFIG_DNS_RESOLVER_LOG_LEVEL_DBG=n

# SNTP
CONFIG_SNTP=y
CONFIG_POSIX_TIMERS=y
CONFIG_NET_CONFIG_CLOCK_SNTP_INIT=y
CONFIG_NET_CONFIG_SNTP_INIT_SERVER="0.pool.ntp.org"

# MQTT
CONFIG_MQTT_LIB=y
CONFIG_MQTT_LIB_TLS=y
CONFIG_MQTT_KEEPALIVE=60
CONFIG_MQTT_LIB_TLS_USE_ALPN=y

# TLS
CONFIG_MBEDTLS=y
CONFIG_MBEDTLS_BUILTIN=y
CONFIG_MBEDTLS_ENABLE_HEAP=y
CONFIG_MBEDTLS_HEAP_SIZE=65536
CONFIG_MBEDTLS_SSL_MAX_CONTENT_LEN=16384
CONFIG_MBEDTLS_PEM_CERTIFICATE_FORMAT=y
CONFIG_MBEDTLS_SERVER_NAME_INDICATION=y
CONFIG_MBEDTLS_AES_ROM_TABLES=y
CONFIG_MBEDTLS_TLS_VERSION_1_2=y
CONFIG_MBEDTLS_MEMORY_DEBUG=y
CONFIG_MBEDTLS_HAVE_TIME_DATE=y
CONFIG_MBEDTLS_SSL_ALPN=y


CONFIG_ENTROPY_GENERATOR=y
CONFIG_TEST_RANDOM_GENERATOR=y
CONFIG_HW_STACK_PROTECTION=y
CONFIG_REQUIRES_FULL_LIBC=y

CONFIG_JSON_LIBRARY=y
CONFIG_NET_SOCKETS=y
CONFIG_NET_SOCKETS_SOCKOPT_TLS=y

CONFIG_POSIX_API=y
```

## dwa.conf
```kconfig
# Matter config
CONFIG_CHIP=y
CONFIG_STD_CPP17=y
CONFIG_CHIP_DEVICE_PRODUCT_NAME="NXP DWA app"
CONFIG_CHIP_DEVICE_TYPE=115

#CONFIG_CHIP_WIFI=y

#
# copied from thermostat/nxp/zephyr/prj.conf
#
CONFIG_CHIP_PROJECT_CONFIG="${THERMOSTAT_NXP_ROOT}/main/include/CHIPProjectConfig.h":
CONFIG_CHIP_ENABLE_PAIRING_AUTOSTART=y
CONFIG_CHIP_DEVICE_PRODUCT_ID=32769
CONFIG_CHIP_DEVICE_PRODUCT_NAME="Thermostat"
CONFIG_CHIP_DEVICE_DISCRIMINATOR=0x800

# Bluetooth overrides
CONFIG_BT_DEVICE_NAME="Thermostat"

# Additional configs for debbugging experience.
CONFIG_THREAD_NAME=y
CONFIG_MPU_STACK_GUARD=y

CONFIG_DEBUG=y
CONFIG_DEBUG_INFO=y
CONFIG_DEBUG_THREAD_INFO=y
# use this config if stepping during debug session is not consistent
# CONFIG_NO_OPTIMIZATIONS=y
CONFIG_ASSERT=y
# by default west will generate the full assembly output, which can take several minutes when binaries are large
CONFIG_OUTPUT_DISASSEMBLY=n

# enable Matter CLI
CONFIG_CHIP_LIB_SHELL=y

# Build in DWA
CONFIG_BUILD_IN_DWA=y
```

## overlay-enterprise-variable-bufs.conf
```kconfig
CONFIG_WIFI_NM_WPA_SUPPLICANT_CRYPTO_ENTERPRISE=y
# EAP frames are ~1100 bytes, so, for efficiency, we set the data size to 1100
CONFIG_NET_BUF_DATA_SIZE=1100
# Use variable data size to reduce memory usage for small data packets
CONFIG_NET_BUF_VARIABLE_DATA_SIZE=y
# For TLS and X.509 processing MbedTLS needs large heap size and using separate heap
# for MbedTLS gives us more control over the heap size.
```

## overlay-enterprise.conf
```kconfig
#CONFIG_WIFI_NM_WPA_SUPPLICANT_CRYPTO_ENTERPRISE=y
# EAP frames are ~1100 bytes, so, need higher packet counts as default packet size is 128
#CONFIG_NET_PKT_TX_COUNT=36
#CONFIG_NET_PKT_RX_COUNT=36
#CONFIG_NET_BUF_TX_COUNT=72
#CONFIG_NET_BUF_RX_COUNT=36
# For TLS and X.509 processing MbedTLS needs large heap size and using separate heap
# for MbedTLS gives us more control over the heap size.
#CONFIG_MBEDTLS_ENABLE_HEAP=y
#CONFIG_MBEDTLS_HEAP_SIZE=55000
```

## boards/frdm_rw612.conf
```kconfig
CONFIG_WIFI_NXP=y
CONFIG_NXP_RW610=y
CONFIG_NXP_WIFI_SHELL=y

#
# C Library
#
CONFIG_REQUIRES_FULL_LIBC=y
CONFIG_CBPRINTF_FP_SUPPORT=y

# log
CONFIG_WIFI_LOG_LEVEL_DBG=y
CONFIG_THREAD_LOCAL_STORAGE=y
CONFIG_ASSERT=y
CONFIG_ASSERT_LEVEL=2
CONFIG_LOG_MODE_IMMEDIATE=y
CONFIG_LOG_PRINTK=n

# os
CONFIG_THREAD_CUSTOM_DATA=y
CONFIG_EVENTS=y
CONFIG_SYS_HEAP_AUTO=y
CONFIG_SCHED_MULTIQ=y
CONFIG_ZVFS_OPEN_MAX=30

# shell
CONFIG_SHELL_ARGC_MAX=48
CONFIG_WIFI_SHELL_MAX_AP_STA=8
CONFIG_WIFI_MGMT_AP_MAX_NUM_STA=8
CONFIG_SHELL_CMD_BUFF_SIZE=512

# net
CONFIG_NET_L2_ETHERNET=y
CONFIG_NET_IPV4=y
CONFIG_NET_IPV6=y
CONFIG_NET_ZPERF=y
CONFIG_NET_ZPERF_MAX_PACKET_SIZE=1500
CONFIG_NET_BUF_LOG=y
CONFIG_NET_PKT_RX_COUNT=36
CONFIG_NET_PKT_TX_COUNT=36
CONFIG_NET_BUF_RX_COUNT=40
CONFIG_NET_BUF_TX_COUNT=40
CONFIG_NET_BUF_DATA_SIZE=1744
CONFIG_NET_TCP_MAX_SEND_WINDOW_SIZE=46720
CONFIG_NET_TCP_MAX_RECV_WINDOW_SIZE=46720
CONFIG_NET_TC_TX_COUNT=1
CONFIG_NET_TC_RX_COUNT=1
CONFIG_NET_MGMT_EVENT_QUEUE_SIZE=20
CONFIG_NET_IF_MAX_IPV4_COUNT=2
CONFIG_NET_IF_MAX_IPV6_COUNT=2
CONFIG_DNS_RESOLVER=y
CONFIG_DNS_RESOLVER_MAX_SERVERS=2
CONFIG_NET_SOCKETS_POLL_MAX=14
CONFIG_NET_ZPERF_MAX_SESSIONS=6
CONFIG_NET_IPV4_FRAGMENT=y
CONFIG_NET_IPV4_FRAGMENT_MAX_COUNT=3
CONFIG_NET_IPV4_FRAGMENT_MAX_PKT=7
CONFIG_NET_IPV4_FRAGMENT_TIMEOUT=3
CONFIG_NET_IPV6_FRAGMENT=y
CONFIG_NET_IPV6_FRAGMENT_MAX_COUNT=3
CONFIG_NET_IPV6_FRAGMENT_MAX_PKT=8
CONFIG_NET_IPV6_FRAGMENT_TIMEOUT=3
CONFIG_NET_MAX_CONN=10
CONFIG_ETH_DRIVER=n

# net threads priority
CONFIG_NET_TC_THREAD_PRIO_CUSTOM=y
CONFIG_NET_TC_THREAD_PREEMPTIVE=y
CONFIG_NET_TCP_WORKER_PRIO=-16
CONFIG_NET_TC_TX_THREAD_BASE_PRIO=3
CONFIG_NET_TC_RX_THREAD_BASE_PRIO=3
CONFIG_ZPERF_WORK_Q_THREAD_PRIORITY=3
CONFIG_NET_SOCKETS_SERVICE_THREAD_PRIO=3
CONFIG_NET_TC_TX_SKIP_FOR_HIGH_PRIO=y
CONFIG_NET_CONTEXT_PRIORITY=y
CONFIG_NET_MGMT_THREAD_PRIO_CUSTOM=y
CONFIG_NET_MGMT_THREAD_PRIORITY=3

# power management
CONFIG_PM=y
CONFIG_PM_DEVICE=y
CONFIG_PM_LOG_LEVEL_OFF=y
CONFIG_PM_DEVICE_LOG_LEVEL_OFF=y
CONFIG_IDLE_STACK_SIZE=1024

# stack size
CONFIG_SHELL_STACK_SIZE=6144
#CONFIG_SYSTEM_WORKQUEUE_STACK_SIZE=2048
CONFIG_SYSTEM_WORKQUEUE_STACK_SIZE=4096


CONFIG_NET_MGMT_EVENT_STACK_SIZE=4608
CONFIG_NET_TCP_WORKQ_STACK_SIZE=2048
CONFIG_MAIN_STACK_SIZE=4096
CONFIG_NET_SOCKETS_SERVICE_STACK_SIZE=4096

# optimization level
# refer to Kconfig.zephyr for Optimizations Level
CONFIG_SPEED_OPTIMIZATIONS=y
#CONFIG_SIZE_OPTIMIZATIONS=y
#CONFIG_DEBUG_OPTIMIZATIONS=y
#CONFIG_NO_OPTIMIZATIONS=y

# debug & stats
CONFIG_SYS_HEAP_VALIDATE=y
CONFIG_SYS_HEAP_RUNTIME_STATS=y
#CONFIG_NET_PKT_TXTIME_STATS=y
#CONFIG_NET_PKT_TXTIME_STATS_DETAIL=y
CONFIG_NET_STATISTICS_WIFI=y
CONFIG_NET_STATISTICS_USER_API=y
#CONFIG_NET_STATISTICS_PERIODIC_OUTPUT=y
#CONFIG_NET_BUF_POOL_USAGE=y
#CONFIG_NET_DEBUG_NET_PKT_ALLOC=y

# stack size for -O0
#CONFIG_SHELL_STACK_SIZE=8192
#CONFIG_NET_TCP_WORKQ_STACK_SIZE=4096
#CONFIG_NET_TX_STACK_SIZE=4096
#CONFIG_NET_RX_STACK_SIZE=4096
#CONFIG_SYSTEM_WORKQUEUE_STACK_SIZE=4096
#CONFIG_ZPERF_WORK_Q_STACK_SIZE=4096
#CONFIG_MAIN_STACK_SIZE=4096
#CONFIG_IDLE_STACK_SIZE=2048

# comment out for -O0
CONFIG_CODE_DATA_RELOCATION_SRAM=y
```

## boards/overlay_hostap_rw612.conf
```kconfig
# wpa_supplicant
CONFIG_WIFI_NM_WPA_SUPPLICANT=y
CONFIG_WIFI_NM_WPA_SUPPLICANT_CLI=y
CONFIG_WIFI_NM_WPA_SUPPLICANT_CRYPTO_ALT=y
CONFIG_WIFI_NM_WPA_SUPPLICANT_CRYPTO_ENTERPRISE=y
CONFIG_WIFI_NM_WPA_SUPPLICANT_DPP=y
CONFIG_WIFI_NM_WPA_SUPPLICANT_EAPOL=y
#CONFIG_WIFI_NM_WPA_SUPPLICANT_CRYPTO_MBEDTLS_PSA=y
CONFIG_WIFI_NM_WPA_SUPPLICANT_INF_MON=n
CONFIG_WIFI_NM_MAX_MANAGED_INTERFACES=2
#CONFIG_SAE_PWE_EARLY_EXIT=y
#CONFIG_WIFI_NM_WPA_SUPPLICANT_WPS=y

#priority
CONFIG_WIFI_NM_WPA_SUPPLICANT_WQ_PRIO=3
CONFIG_WIFI_NM_WPA_SUPPLICANT_PRIO=3

# stack size
#CONFIG_WIFI_NM_WPA_SUPPLICANT_WQ_STACK_SIZE=12288
#CONFIG_WIFI_NM_WPA_SUPPLICANT_THREAD_STACK_SIZE=12288

# stack size for -O0
#CONFIG_WIFI_NM_WPA_SUPPLICANT_WQ_STACK_SIZE=16384
#CONFIG_WIFI_NM_WPA_SUPPLICANT_THREAD_STACK_SIZE=16384

# debug level
#CONFIG_WIFI_NM_WPA_SUPPLICANT_DEBUG_LEVEL=2
#CONFIG_WIFI_NM_WPA_SUPPLICANT_LOG_LEVEL_INF=y
```

## src/wifi_test.c
```c
/*
 * Copyright (c) 2016 Intel Corporation.
 *
 * SPDX-License-Identifier: Apache-2.0
 */

#include <zephyr/kernel.h>
#include <errno.h>
#include "creds/creds.h"

#include <errno.h>
#include <stdio.h>
#include <stdlib.h>

#include <zephyr/net/socket.h>
#include <zephyr/net/dns_resolve.h>
#include <zephyr/net/mqtt.h>
#include <zephyr/net/tls_credentials.h>
#include <zephyr/data/json.h>
#include <zephyr/random/random.h>
#include <zephyr/logging/log.h>
#include "net_sample_common.h"
#include <zephyr/net/sntp.h>
#include <zephyr/posix/time.h>


#if defined(CONFIG_MBEDTLS_MEMORY_DEBUG)
#include <mbedtls/memory_buffer_alloc.h>
#endif

LOG_MODULE_REGISTER(aws, LOG_LEVEL_DBG);

#define SNTP_SERVER "0.pool.ntp.org"

#define AWS_BROKER_PORT CONFIG_AWS_MQTT_PORT

#define MQTT_BUFFER_SIZE 256u
#define APP_BUFFER_SIZE	 4096u

#define MAX_RETRIES	    10u
#define BACKOFF_EXP_BASE_MS 1000u
#define BACKOFF_EXP_MAX_MS  60000u
#define BACKOFF_CONST_MS    5000u

K_THREAD_STACK_DEFINE(aws_stack, 4096);
struct k_thread aws_thread;

static struct sockaddr_in aws_broker;

uint8_t NetworkUp = 0;

static uint8_t rx_buffer[MQTT_BUFFER_SIZE];
static uint8_t tx_buffer[MQTT_BUFFER_SIZE];
static uint8_t buffer[APP_BUFFER_SIZE]; /* Shared between published and received messages */

static struct mqtt_client client_ctx;

static const char mqtt_client_name[] = CONFIG_AWS_THING_NAME;

static uint32_t messages_received_counter;
static bool do_publish;	  /* Trigger client to publish */
static bool do_subscribe; /* Trigger client to subscribe */

#if (CONFIG_AWS_MQTT_PORT == 443 && !defined(CONFIG_MQTT_LIB_WEBSOCKET))
static const char * const alpn_list[] = {"x-amzn-mqtt-ca"};
#endif

#define TLS_TAG_DEVICE_CERTIFICATE 1
#define TLS_TAG_DEVICE_PRIVATE_KEY 1
#define TLS_TAG_AWS_CA_CERTIFICATE 2

static const sec_tag_t sec_tls_tags[] = {
	TLS_TAG_DEVICE_CERTIFICATE,
	TLS_TAG_AWS_CA_CERTIFICATE,
};

static int setup_credentials(void)
{
	int ret;

	ret = tls_credential_add(TLS_TAG_DEVICE_CERTIFICATE, TLS_CREDENTIAL_SERVER_CERTIFICATE,
				 public_cert, public_cert_len);
	if (ret < 0) {
		LOG_ERR("Failed to add device certificate: %d", ret);
		goto exit;
	}

	ret = tls_credential_add(TLS_TAG_DEVICE_PRIVATE_KEY, TLS_CREDENTIAL_PRIVATE_KEY,
				 private_key, private_key_len);
	if (ret < 0) {
		LOG_ERR("Failed to add device private key: %d", ret);
		goto exit;
	}

	ret = tls_credential_add(TLS_TAG_AWS_CA_CERTIFICATE, TLS_CREDENTIAL_CA_CERTIFICATE, ca_cert,
				 ca_cert_len);
	if (ret < 0) {
		LOG_ERR("Failed to add device private key: %d", ret);
		goto exit;
	}

exit:
	return ret;
}

static int subscribe_topic(void)
{
	int ret;
	struct mqtt_topic topics[] = {{
		.topic = {.utf8 = CONFIG_AWS_SUBSCRIBE_TOPIC,
			  .size = strlen(CONFIG_AWS_SUBSCRIBE_TOPIC)},
		.qos = CONFIG_AWS_QOS,
	}};
	const struct mqtt_subscription_list sub_list = {
		.list = topics,
		.list_count = ARRAY_SIZE(topics),
		.message_id = 1u,
	};

	LOG_INF("Subscribing to %hu topic(s)", sub_list.list_count);

	ret = mqtt_subscribe(&client_ctx, &sub_list);
	if (ret != 0) {
		LOG_ERR("Failed to subscribe to topics: %d", ret);
	}

	return ret;
}

static int publish_message(const char *topic, size_t topic_len, uint8_t *payload,
			   size_t payload_len)
{
	static uint32_t message_id = 1u;

	int ret;
	struct mqtt_publish_param msg;

	msg.retain_flag = 0u;
	msg.dup_flag = 0u;
	msg.message.topic.topic.utf8 = topic;
	msg.message.topic.topic.size = topic_len;
	msg.message.topic.qos = CONFIG_AWS_QOS;
	msg.message.payload.data = payload;
	msg.message.payload.len = payload_len;
	msg.message_id = message_id++;

	ret = mqtt_publish(&client_ctx, &msg);
	if (ret != 0) {
		LOG_ERR("Failed to publish message: %d", ret);
	}

	LOG_INF("PUBLISHED on topic \"%s\" [ id: %u qos: %u ], payload: %u B", topic,
		msg.message_id, msg.message.topic.qos, payload_len);
	LOG_HEXDUMP_DBG(payload, payload_len, "Published payload:");

	return ret;
}

static ssize_t handle_published_message(const struct mqtt_publish_param *pub)
{
	int ret;
	size_t received = 0u;
	const size_t message_size = pub->message.payload.len;
	const bool discarded = message_size > APP_BUFFER_SIZE;

	LOG_INF("RECEIVED on topic \"%s\" [ id: %u qos: %u ] payload: %u / %u B",
		(const char *)pub->message.topic.topic.utf8, pub->message_id,
		pub->message.topic.qos, message_size, APP_BUFFER_SIZE);

	while (received < message_size) {
		uint8_t *p = discarded ? buffer : &buffer[received];

		ret = mqtt_read_publish_payload_blocking(&client_ctx, p, APP_BUFFER_SIZE);
		if (ret < 0) {
			return ret;
		}

		received += ret;
	}

	if (!discarded) {
		LOG_HEXDUMP_DBG(buffer, MIN(message_size, 256u), "Received payload:");
	}

	/* Send ACK */
	switch (pub->message.topic.qos) {
	case MQTT_QOS_1_AT_LEAST_ONCE: {
		struct mqtt_puback_param puback;

		puback.message_id = pub->message_id;
		mqtt_publish_qos1_ack(&client_ctx, &puback);
	} break;
	case MQTT_QOS_2_EXACTLY_ONCE: /* unhandled (not supported by AWS) */
	case MQTT_QOS_0_AT_MOST_ONCE: /* nothing to do */
	default:
		break;
	}

	return discarded ? -ENOMEM : received;
}

const char *mqtt_evt_type_to_str(enum mqtt_evt_type type)
{
	static const char *const types[] = {
		"CONNACK", "DISCONNECT", "PUBLISH", "PUBACK",	"PUBREC",
		"PUBREL",  "PUBCOMP",	 "SUBACK",  "UNSUBACK", "PINGRESP",
	};

	return (type < ARRAY_SIZE(types)) ? types[type] : "<unknown>";
}

static void mqtt_event_cb(struct mqtt_client *client, const struct mqtt_evt *evt)
{
	LOG_DBG("MQTT event: %s [%u] result: %d", mqtt_evt_type_to_str(evt->type), evt->type,
		evt->result);

	switch (evt->type) {
	case MQTT_EVT_CONNACK: {
		do_subscribe = true;
	} break;

	case MQTT_EVT_PUBLISH: {
		const struct mqtt_publish_param *pub = &evt->param.publish;

		handle_published_message(pub);
		messages_received_counter++;
#if !defined(CONFIG_AWS_TEST_SUITE_RECV_QOS1)
		do_publish = true;
#endif
	} break;

	case MQTT_EVT_SUBACK: {
#if !defined(CONFIG_AWS_TEST_SUITE_RECV_QOS1)
		do_publish = true;
#endif
	} break;

	case MQTT_EVT_PUBACK:
	case MQTT_EVT_DISCONNECT:
	case MQTT_EVT_PUBREC:
	case MQTT_EVT_PUBREL:
	case MQTT_EVT_PUBCOMP:
	case MQTT_EVT_PINGRESP:
	case MQTT_EVT_UNSUBACK:
	default:
		break;
	}
}

static void aws_client_setup(void)
{
	mqtt_client_init(&client_ctx);

	client_ctx.broker = &aws_broker;
	client_ctx.evt_cb = mqtt_event_cb;

	client_ctx.client_id.utf8 = (uint8_t *)mqtt_client_name;
	client_ctx.client_id.size = sizeof(mqtt_client_name) - 1;
	client_ctx.password = NULL;
	client_ctx.user_name = NULL;

	client_ctx.keepalive = CONFIG_MQTT_KEEPALIVE;

	client_ctx.protocol_version = MQTT_VERSION_3_1_1;

	client_ctx.rx_buf = rx_buffer;
	client_ctx.rx_buf_size = MQTT_BUFFER_SIZE;
	client_ctx.tx_buf = tx_buffer;
	client_ctx.tx_buf_size = MQTT_BUFFER_SIZE;

	/* setup TLS */
	client_ctx.transport.type = MQTT_TRANSPORT_SECURE;
	struct mqtt_sec_config *const tls_config = &client_ctx.transport.tls.config;

	tls_config->peer_verify = TLS_PEER_VERIFY_REQUIRED;
	tls_config->cipher_list = NULL;
	tls_config->sec_tag_list = sec_tls_tags;
	tls_config->sec_tag_count = ARRAY_SIZE(sec_tls_tags);
	tls_config->hostname = CONFIG_AWS_ENDPOINT;
	tls_config->cert_nocopy = TLS_CERT_NOCOPY_NONE;
#if (CONFIG_AWS_MQTT_PORT == 443 && !defined(CONFIG_MQTT_LIB_WEBSOCKET))
	tls_config->alpn_protocol_name_list = alpn_list;
	tls_config->alpn_protocol_name_count = ARRAY_SIZE(alpn_list);
#endif
}

struct backoff_context {
	uint16_t retries_count;
	uint16_t max_retries;

#if defined(CONFIG_AWS_EXPONENTIAL_BACKOFF)
	uint32_t attempt_max_backoff; /* ms */
	uint32_t max_backoff;	      /* ms */
#endif
};

static void backoff_context_init(struct backoff_context *bo)
{
	__ASSERT_NO_MSG(bo != NULL);

	bo->retries_count = 0u;
	bo->max_retries = MAX_RETRIES;

#if defined(CONFIG_AWS_EXPONENTIAL_BACKOFF)
	bo->attempt_max_backoff = BACKOFF_EXP_BASE_MS;
	bo->max_backoff = BACKOFF_EXP_MAX_MS;
#endif
}

/* https://aws.amazon.com/blogs/architecture/exponential-backoff-and-jitter/ */
static void backoff_get_next(struct backoff_context *bo, uint32_t *next_backoff_ms)
{
	__ASSERT_NO_MSG(bo != NULL);
	__ASSERT_NO_MSG(next_backoff_ms != NULL);

#if defined(CONFIG_AWS_EXPONENTIAL_BACKOFF)
	if (bo->retries_count <= bo->max_retries) {
		*next_backoff_ms = sys_rand32_get() % (bo->attempt_max_backoff + 1u);

		/* Calculate max backoff for the next attempt (~ 2**attempt) */
		bo->attempt_max_backoff = MIN(bo->attempt_max_backoff * 2u, bo->max_backoff);
		bo->retries_count++;
	}
#else
	*next_backoff_ms = BACKOFF_CONST_MS;
#endif
}

static int aws_client_try_connect(void)
{
	int ret;
	uint32_t backoff_ms;
	struct backoff_context bo;

	backoff_context_init(&bo);

	while (bo.retries_count <= bo.max_retries) {
		ret = mqtt_connect(&client_ctx);
		if (ret == 0) {
			goto exit;
		}

		backoff_get_next(&bo, &backoff_ms);

		LOG_ERR("Failed to connect: %d backoff delay: %u ms", ret, backoff_ms);
		k_msleep(backoff_ms);
	}

exit:
	return ret;
}

struct publish_payload {
	uint32_t counter;
};

static const struct json_obj_descr json_descr[] = {
	JSON_OBJ_DESCR_PRIM(struct publish_payload, counter, JSON_TOK_NUMBER),
};

static int publish(void)
{
	struct publish_payload pl = {.counter = messages_received_counter};

	json_obj_encode_buf(json_descr, ARRAY_SIZE(json_descr), &pl, buffer, sizeof(buffer));

	return publish_message(CONFIG_AWS_PUBLISH_TOPIC, strlen(CONFIG_AWS_PUBLISH_TOPIC), buffer,
			       strlen(buffer));
}

void aws_client_loop(void)
{
	int rc;
	int timeout;
	struct pollfd fds;

	aws_client_setup();
	
	rc = aws_client_try_connect();
	if (rc != 0) {
		goto cleanup;
	}

	fds.fd = client_ctx.transport.tcp.sock;
	fds.events = POLLIN;

	for (;;) {
		timeout = mqtt_keepalive_time_left(&client_ctx);
		rc = poll(&fds, 1u, timeout);
		if (rc >= 0) {
			if (fds.revents & POLLIN) {
				rc = mqtt_input(&client_ctx);
				if (rc != 0) {
					LOG_ERR("Failed to read MQTT input: %d", rc);
					break;
				}
			}

			if (fds.revents & (POLLHUP | POLLERR)) {
				LOG_ERR("Socket closed/error");
				break;
			}

			rc = mqtt_live(&client_ctx);
			if ((rc != 0) && (rc != -EAGAIN)) {
				LOG_ERR("Failed to live MQTT: %d", rc);
				break;
			}
		} else {
			LOG_ERR("poll failed: %d", rc);
			break;
		}

		if (do_publish) {
			do_publish = false;
			publish();
		}

		if (do_subscribe) {
			do_subscribe = false;
			subscribe_topic();
		}
	}
	
cleanup:
	mqtt_disconnect(&client_ctx);
	close(fds.fd);
	fds.fd = -1;
}

static int resolve_broker_addr(struct sockaddr_in *broker)
{
	int ret;
	struct addrinfo *ai = NULL;

	const struct addrinfo hints = {
		.ai_family = AF_INET,
		.ai_socktype = SOCK_STREAM,
		.ai_protocol = 0,
	};
	char port_string[6] = {0};

	sprintf(port_string, "%d", AWS_BROKER_PORT);
	ret = getaddrinfo(CONFIG_AWS_ENDPOINT, port_string, &hints, &ai);
	if (ret == 0) {
		char addr_str[INET_ADDRSTRLEN];

		memcpy(broker, ai->ai_addr, MIN(ai->ai_addrlen, sizeof(struct sockaddr_storage)));

		inet_ntop(AF_INET, &broker->sin_addr, addr_str, sizeof(addr_str));
		LOG_INF("Resolved: %s:%u", addr_str, htons(broker->sin_port));
	} else {
		LOG_ERR("failed to resolve hostname err = %d (errno = %d)", ret, errno);
	}
	
	freeaddrinfo(ai);
	return ret;
}

void wait_for_network_ip(void){
    struct net_if *iface = net_if_get_default();

    while (!net_if_is_up(iface) ||
           !net_if_ipv4_get_global_addr(iface, NET_ADDR_ANY)) {
        printk("Waiting for DHCP lease...\n");
        k_sleep(K_MSEC(500));
    }
    printk("Network is ready, IP acquired!\n");
}

static void handler(struct net_mgmt_event_callback *cb,
                    uint32_t event, struct net_if *iface)
{
    if (event == NET_EVENT_IPV4_ADDR_ADD) {
        printk("DHCP lease acquired: starting AWS...\n");
        NetworkUp = 1;
    }
}

void sync_time(void)
{
    struct sntp_time sntp_time;int err;

    /* Query an NTP server with 2s timeout */
	err = sntp_simple("pool.ntp.org", 2000, &sntp_time);
    if (err) {
        printk("SNTP request failed: %d\n", err);
        return;
    }

    /* Convert SNTP result to timespec */struct timespec ts = {
        .tv_sec = sntp_time.seconds,
        .tv_nsec = ((uint64_t)sntp_time.fraction * NSEC_PER_SEC) >> 32,
    };

    /* Set Zephyr system clock */if (clock_settime(CLOCK_REALTIME, &ts) == 0) {
        printk("System time set: %lld\n", (long long)ts.tv_sec);
    } else {
        printk("Failed to set system time\n");
    }
}

void aws_thread_entry(void *, void *, void *)
{
   	//wait_for_network_ip();
	while(!NetworkUp)
	{
		k_sleep(K_MSEC(1000));
	}
	
	sync_time();
	
	for (;;) {
		resolve_broker_addr(&aws_broker);

		aws_client_loop();

#if defined(CONFIG_MBEDTLS_MEMORY_DEBUG)
		size_t cur_used, cur_blocks, max_used, max_blocks;
		mbedtls_memory_buffer_alloc_cur_get(&cur_used, &cur_blocks);
		mbedtls_memory_buffer_alloc_max_get(&max_used, &max_blocks);
		LOG_INF("mbedTLS heap usage: MAX %u/%u (%u) CUR %u (%u)", max_used,
			CONFIG_MBEDTLS_HEAP_SIZE, max_blocks, cur_used, cur_blocks);
#endif

		k_sleep(K_SECONDS(1));
	}
}

void start_aws_thread(void)
{
    k_thread_create(&aws_thread, aws_stack, K_THREAD_STACK_SIZEOF(aws_stack),
                    aws_thread_entry, NULL, NULL, NULL,
                    K_PRIO_PREEMPT(8), 0, K_NO_WAIT);
}

int main(void)
{
	static struct net_mgmt_event_callback cb;
    net_mgmt_init_event_callback(&cb, handler,
                                 NET_EVENT_IPV4_ADDR_ADD);
    net_mgmt_add_event_callback(&cb);
	
	setup_credentials();
	start_aws_thread();

	return 0;
}
```
